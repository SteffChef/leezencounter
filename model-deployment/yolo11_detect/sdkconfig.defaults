## model-deployment/yolo11_detect/sdkconfig.defaults
```kconfig
# CONFIG_AUTOSTART_ARDUINO is not set
CONFIG_ARDUHAL_ESP_LOG=y

# Arduino TinyUSB
#

CONFIG_TINYUSB_ENABLED=y


#
# Serial (CDC) driver
#

CONFIG_TINYUSB_CDC_ENABLED=y
CONFIG_TINYUSB_DESC_CDC_STRING="Espressif CDC Device"
CONFIG_TINYUSB_CDC_RX_BUFSIZE=64
CONFIG_TINYUSB_CDC_TX_BUFSIZE=64
CONFIG_TINYUSB_CDC_MAX_PORTS=2

# end of Serial (CDC) driver


#
# Mass Storage (MSC) driver
#

CONFIG_TINYUSB_MSC_ENABLED=y
CONFIG_TINYUSB_DESC_MSC_STRING="Espressif MSC Device"
CONFIG_TINYUSB_MSC_BUFSIZE=4096
# end of Mass Storage (MSC) driver


#
# Human Interface (HID) driver
#

CONFIG_TINYUSB_HID_ENABLED=y
CONFIG_TINYUSB_DESC_HID_STRING="Espressif HID Device"
CONFIG_TINYUSB_HID_BUFSIZE=64

# end of Human Interface (HID) driver

#
# MIDI driver
#

CONFIG_TINYUSB_MIDI_ENABLED=y
CONFIG_TINYUSB_DESC_MIDI_STRING="Espressif MIDI Device"
CONFIG_TINYUSB_MIDI_RX_BUFSIZE=64
CONFIG_TINYUSB_MIDI_TX_BUFSIZE=64
# end of MIDI driver


#
# VIDEO driver
#

CONFIG_TINYUSB_VIDEO_ENABLED=y
CONFIG_TINYUSB_DESC_VIDEO_STRING="Espressif VIDEO Device"
CONFIG_TINYUSB_VIDEO_STREAMING_BUFSIZE=64
CONFIG_TINYUSB_VIDEO_STREAMING_IFS=1
# end of VIDEO driver


#
# DFU Runtime driver
#

CONFIG_TINYUSB_DFU_RT_ENABLED=y
CONFIG_TINYUSB_DESC_DFU_RT_STRING="Espressif DFU_RT Device"
# end of DFU Runtime driver


#
# DFU driver
#

CONFIG_TINYUSB_DFU_ENABLED=y
CONFIG_TINYUSB_DESC_DFU_STRING="Espressif DFU Device"
CONFIG_TINYUSB_DFU_BUFSIZE=4096
# end of DFU driver


#
# VENDOR driver
#

CONFIG_TINYUSB_VENDOR_ENABLED=y
CONFIG_TINYUSB_DESC_VENDOR_STRING="Espressif VENDOR Device"
CONFIG_TINYUSB_VENDOR_RX_BUFSIZE=64
CONFIG_TINYUSB_VENDOR_TX_BUFSIZE=64
# end of VENDOR driver


#
# NCM driver
#

CONFIG_TINYUSB_NCM_ENABLED=y

# end of NCM driver

CONFIG_TINYUSB_DEBUG_LEVEL=0
# end of Arduino TinyUSB


#
# ESP-NN
#

# CONFIG_NN_ANSI_C is not set
CONFIG_NN_OPTIMIZED=y
CONFIG_NN_OPTIMIZATIONS=1

# end of ESP-NN


# CONFIG_ESP_RMAKER_ASSISTED_CLAIM is not set
CONFIG_ESP_RMAKER_USER_ID_CHECK=y
CONFIG_ESP_RMAKER_SKIP_VERSION_CHECK=y

CONFIG_COMPILER_OPTIMIZATION_SIZE=y
# CONFIG_COMPILER_OPTIMIZATION_PERF is not set
CONFIG_ESP_COEX_SW_COEXIST_ENABLE=y
# CONFIG_ESP_COEX_POWER_MANAGEMENT is not set
CONFIG_I2S_ISR_IRAM_SAFE=y


#
# ESP-Driver:SPI Configurations
#

# CONFIG_SPI_MASTER_IN_IRAM is not set
# CONFIG_SPI_MASTER_ISR_IN_IRAM is not set
# CONFIG_SPI_SLAVE_IN_IRAM is not set
# CONFIG_SPI_SLAVE_ISR_IN_IRAM is not set

# end of ESP-Driver:SPI Configurations

#
# ESP HTTP client
#

CONFIG_ESP_HTTP_CLIENT_ENABLE_HTTPS=y
CONFIG_ESP_HTTP_CLIENT_ENABLE_BASIC_AUTH=y
# CONFIG_ESP_HTTP_CLIENT_ENABLE_DIGEST_AUTH is not set
# CONFIG_ESP_HTTP_CLIENT_ENABLE_CUSTOM_TRANSPORT is not set
CONFIG_ESP_HTTP_CLIENT_EVENT_POST_TIMEOUT=2000
# end of ESP HTTP client



#
# HTTP Server
#

CONFIG_HTTPD_MAX_REQ_HDR_LEN=1024
CONFIG_HTTPD_MAX_URI_LEN=512
CONFIG_HTTPD_ERR_RESP_NO_DELAY=y
CONFIG_HTTPD_PURGE_BUF_LEN=32
# CONFIG_HTTPD_LOG_PURGE_DATA is not set
CONFIG_HTTPD_WS_SUPPORT=y


#
# ESP HTTPS server
#

CONFIG_ESP_HTTPS_SERVER_ENABLE=y
CONFIG_ESP_HTTPS_SERVER_EVENT_POST_TIMEOUT=2000
# CONFIG_ESP_HTTPS_SERVER_CERT_SELECT_HOOK is not set
# end of ESP HTTPS server


#
# ESP PSRAM
#

CONFIG_SPIRAM=y

#
# SPI RAM config
#

# CONFIG_SPIRAM_MODE_QUAD is not set
CONFIG_SPIRAM_MODE_OCT=y

#
# Core dump
#

#
# Log Level
#

# CONFIG_LOG_MAXIMUM_LEVEL_WARN is not set
# CONFIG_LOG_MAXIMUM_LEVEL_INFO is not set

CONFIG_FREERTOS_HZ=1000
```
